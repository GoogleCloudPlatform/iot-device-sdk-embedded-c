## examples/espressif/esp32-gateway/Gateway-device/main/Kconfig.projbuild
```kconfig
menu "Example Configuration"

config ESP_WIFI_SSID
    string "WiFi SSID"
    default "myssid"
    help
	SSID (network name) for the example to connect to.

config ESP_WIFI_PASSWORD
    string "WiFi Password"
    default "mypassword"
    help
	WiFi password (WPA or WPA2) for the example to use.

config OUTPUT_GPIO
    int "Output GPIO"
    default 27
    help
    This is the GPIO on which output will be set.

config GIOT_PROJECT_ID
    string "Google Cloud Project ID"
    default "project_id"
    help
        Google Cloud project ID

config GIOT_LOCATION
    string "Google Cloud location"
    default "us-central1-a"
    help
        Google Cloud region

config GIOT_REGISTRY_ID
    string "Google IoT Core Registry ID"
    default "registry_id"
    help
        Google IoT Core registry id

config GIOT_DEVICE_ID
    string "Google IoT Core Device ID"
    default "device_id"
    help
        Google IoT Core device id

config GIOT_DEBUG_OUTPUT
    bool "Enable debugging"
    help
        Select this option to enable debugging support

endmenu
```
